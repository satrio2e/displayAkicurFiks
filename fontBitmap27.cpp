#include "fontBitmap27.h"
#include <Fonts/SF_Willamette27pt7b.h>
extern int l;

//
const unsigned char PROGMEM angka_1_bits[] = {0x0f,0x80,0x1f,0x80,0x3f,0x80,0x7f,0x80,0xff,0x80,0xff,0x80,0x0f,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0x0f,0x80};
const unsigned char PROGMEM angka_4_bits[] = {0x00,0x3c,0x00,0x3c,0x00,0x7c,0x00,0x7c,0x00,0xfc,0x00,0xfc,0x01,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0x00,0x7c};
const unsigned char PROGMEM angka_7_bits[] = {0xff,0xfc,0xff,0xfc,0xff,0xf8,0xff,0xf8,0x00,0xf8,0x01,0xf8,0x01,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0xf8,0x00};
const unsigned char PROGMEM angka_K_bits[] = {0xf8,0x7c,0xf8,0x7c,0xf8,0x7c,0xf8,0x7c,0xf8,0x7c,0xf8,0x7c,0xf8,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0xf8,0x7c};
const unsigned char PROGMEM angka_M_bits[] = {0xfc,0x00,0x7e,0xfc,0x00,0x7e,0xfe,0x00,0xfe,0xfe,0x00,0xfe,0xff,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0x00,0x3e};
const unsigned char PROGMEM angka_N_bits[] = {0xfc,0x07,0xc0,0xfc,0x07,0xc0,0xfc,0x07,0xc0,0xfe,0x07,0xc0,0xfe,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0x07,0xc0};
const unsigned char PROGMEM angka_T_bits[] = {0xff,0xfe,0xff,0xfe,0xff,0xfe,0xff,0xfe,0x07,0xc0,0x07,0xc0,0x07,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0x07,0xc0};
const unsigned char PROGMEM angka_Z_bits[] = {0xff,0xfc,0xff,0xfc,0xff,0xf8,0xff,0xf8,0x00,0xf8,0x01,0xf8,0x01,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0xff,0xfc};
const unsigned char PROGMEM angka_W_bits[] = {0xf8,0x7c,0x3e,0xf8,0x7c,0x3e,0xf8,0x7c,0x3e,0xf8,0x7c,0x3e,0xf8,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0x83,0xe0};
const unsigned char PROGMEM angka_per_bits[] = {0x00,0x78,0x00,0xf8,0x00,0xf0,0x00,0xf0,0x00,0xf0,0x01,0xf0,0x01,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0xf0,0x00};
//


int getCharWidth(char c) {
  // lebar karakter biasa
  if (c == ' ') return 5;
  else if (c == 'I' || c == '.' || c == ',' || c == ':') return 7;
  else if (c == 'J' || c == 'T') return 15;
  else if (c == 'E' || c == 'F' || c == 'L' || c == '"') return 14;
  else if (c == 'U' || c == 'Y' || c == 'A'|| c == '2' || c == '3' || c == '5' || c == '6' || c == '8' || c == '9' || c == '0') return 16;
  else if (c == 'Q') return 18;
  else if (c == 'M') return 25;
  else if (c == '%') return 32;
  return 16; // default
}

int getTextWidth(const char* input) {
  int width = 0;
  for (int i = 0; i < strlen(input); i++) {
    char c = input[i];
    // bitmap khusus
    if (c == '1') width += 11;
    else if (c == '7') width += 16;
    else if (c == '4') width += 16;
    else if (c == 'K') width += 16;
    else if (c == 'M') width += 25;
    else if (c == 'N') width += 20;
    else if (c == 'Z') width += 16;
    else if (c == 'T') width += 17;
    else if (c == 'W') width += 25;
    else if (c == '/') width += 15;
    else width += getCharWidth(c);
  }
  return width;
}

void drawCharCentered(char* input, uint16_t color, int y) {
virtualDisp->setFont(&SF_Willamette27pt7b);
  int totalWidth = getTextWidth(input);
  l = (128 - totalWidth) / 2; // posisi awal biar tengah

  for (int i = 0; i < strlen(input); i++) {
    char c = input[i];

    if (c == '1') {
      virtualDisp->drawBitmap(l+2, y, angka_1_bits, 9, 35, color);
      l += 11;
      continue;
    }
    if (c == '7') {
      virtualDisp->drawBitmap(l+2, y, angka_7_bits, 14, 35, color);
      l += 16;
      continue;
    }
    if (c == '4') {
      virtualDisp->drawBitmap(l+2, y, angka_4_bits, 14, 35, color);
      l += 16;
      continue;
    }
    if (c == 'K') {
      virtualDisp->drawBitmap(l+2, y, angka_K_bits, 14, 35, color);
      l += 16;
      continue;
    }
    if (c == 'M') {
      virtualDisp->drawBitmap(l+2, y, angka_M_bits, 23, 35, color);
      l += 25;
      continue;
    }
    if (c == 'N') {
      virtualDisp->drawBitmap(l+2, y, angka_N_bits, 23, 35, color);
      l += 20;
      continue;
    }
    if (c == 'Z') {
      virtualDisp->drawBitmap(l+2, y, angka_Z_bits, 14, 35, color);
      l += 16;
      continue;
    }
    if (c == 'T') {
      virtualDisp->drawBitmap(l+2, y, angka_T_bits, 15, 35, color);
      l += 17;
      continue;
    }
    if (c == 'W') {
      virtualDisp->drawBitmap(l+2, y, angka_W_bits, 23, 35, color);
      l += 25;
      continue;
    }
    if (c == '/') {
      virtualDisp->drawBitmap(l+2, y, angka_per_bits, 13, 35, color);
      l += 15;
      continue;
    }

    // karakter biasa
    virtualDisp->drawChar(
      l, (y + 34),
      c,
      color,
      virtualDisp->color444(15, 0, 0),
      1
    );

    l += getCharWidth(c);
  }
}