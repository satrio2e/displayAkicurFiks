#include "fontBitmap20.h"
#include <Fonts/SF_Willamette20pt7b.h>
extern int l;

//
const unsigned char PROGMEM angka_1_20_bits[] = {0x1c,0x3c,0x7c,0xfc,0x3c,0x3c,0x3c,0x3c,0x3c,0x3c,0x3c,0x3c,0x3c,0x3c,0x3c,0x3c,0x3c,0x3c,0x3c,0x3c,0x3c,0x3c,0x3c,0x3c,0x3c,0x3c};
const unsigned char PROGMEM angka_4_20_bits[] = {0x01,0xe0,0x01,0xe0,0x03,0xe0,0x03,0xe0,0x07,0xe0,0x07,0xe0,0x0d,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0x01,0xe0};
const unsigned char PROGMEM angka_7_20_bits[] = {0xff,0xe0,0xff,0xe0,0xff,0xe0,0x03,0xc0,0x03,0xc0,0x03,0xc0,0x07,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0xf0,0x00};
const unsigned char PROGMEM angka_J_20_bits[] = {0x01,0xe0,0x01,0xe0,0x01,0xe0,0x01,0xe0,0x01,0xe0,0x01,0xe0,0x01,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0x1f,0x00};
const unsigned char PROGMEM angka_K_20_bits[] = {0xf1,0xe0,0xf1,0xe0,0xf1,0xe0,0xf1,0xe0,0xf1,0xe0,0xf1,0xe0,0xf1,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0xf1,0xe0};
const unsigned char PROGMEM angka_M_20_bits[] = {0xf0,0x07,0x80,0xf0,0x07,0x80,0xf8,0x0f,0x80,0xf8,0x0f,0x80,0xfc,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0x07,0x80};
const unsigned char PROGMEM angka_N_20_bits[] = {0xf0,0x3c,0xf0,0x3c,0xf8,0x3c,0xf8,0x3c,0xfc,0x3c,0xfc,0x3c,0xf6,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0xf0,0x3c};
const unsigned char PROGMEM angka_T_20_bits[] = {0xff,0xf0,0xff,0xf0,0xff,0xf0,0xff,0xf0,0x0f,0x00,0x0f,0x00,0x0f,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0x0f,0x00};
const unsigned char PROGMEM angka_Z_20_bits[] = {0xff,0xe0,0xff,0xe0,0xff,0xe0,0x03,0xc0,0x03,0xc0,0x03,0xc0,0x07,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0xff,0xe0};
const unsigned char PROGMEM angka_V_20_bits[] = {0xf0,0x78,0xf0,0x78,0xf0,0x78,0xf0,0x78,0xf0,0x78,0xf0,0x78,0xf0,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0x02,0x00};
const unsigned char PROGMEM angka_W_20_bits[] = {0xf0,0x03,0xc0,0xf0,0x03,0xc0,0xf0,0x03,0xc0,0xf0,0x03,0xc0,0xf0,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0xfe,0x00};
const unsigned char PROGMEM angka_per_20_bits[] = {0x03,0x80,0x03,0x80,0x07,0x00,0x07,0x00,0x07,0x00,0x07,0x00,0x0e,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0xe0,0x00};
//


int getCharWidth20(char c) {
  // lebar karakter biasa
  if (c == ' ') return 5;
  else if (c == 'I' || c == '.' || c == ',' || c == ':') return 6;
  else if (c == '-') return 10;
  else if (c == 'Z' || c == 'A') return 12;
  else if (c == 'E' || c == 'F' || c == 'L' || c == '"') return 11;
  else if (c == 'Q') return 14;
  else if (c == '%') return 29;
  return 13; // default
}

int getTextWidth20(const char* input) {
  int width = 0;
  for (int i = 0; i < strlen(input); i++) {
    char c = input[i];
    // bitmap khusus
    if (c == '1') width += 8;
    else if (c == '7') width += 13;
    else if (c == '4') width += 13;
    else if (c == 'J') width += 13;
    else if (c == 'K') width += 13;
    else if (c == 'M') width += 19;
    else if (c == 'N') width += 17;
    else if (c == 'Z') width += 13;
    else if (c == 'T') width += 14;
    else if (c == 'V') width += 17;
    else if (c == 'W') width += 20;
    else if (c == '/') width += 11;
    else width += getCharWidth20(c);
  }
  return width;
}

void drawCharCentered20(const char* input, uint16_t color, int x, int y) {
  static String lastInput = "";  // simpan teks sebelumnya
  static int lastL = -9999;      // simpan posisi X sebelumnya


  virtualDisp->setFont(&SF_Willamette20pt7b);
  int totalWidth = getTextWidth20(input);
  l = (128 - totalWidth) / 2; // posisi awal biar tengah; // posisi awal biar tengah

    // kalau teks berubah atau posisi X berubah → clear screen
  if (lastInput != String(input) || lastL != l) {
    virtualDisp->fillScreen(virtualDisp->color444(0, 0, 0));
    lastInput = String(input);
    lastL = l;
  }

  for (int i = 0; i < strlen(input); i++) {
    char c = input[i];

    if (c == '1') {
      virtualDisp->drawBitmap(l+1, y, angka_1_20_bits, 6, 26, color);
      l += 8;
      continue;
    }
    if (c == '7') {
      virtualDisp->drawBitmap(l+1, y, angka_7_20_bits, 11, 26, color);
      l += 13;
      continue;
    }
    if (c == '4') {
      virtualDisp->drawBitmap(l+2, y, angka_4_20_bits, 11, 26, color);
      l += 13;
      continue;
    }
    if (c == 'J') {
      virtualDisp->drawBitmap(l+2, y, angka_J_20_bits, 11, 26, color);
      l += 13;
      continue;
    }
    if (c == 'K') {
      virtualDisp->drawBitmap(l+2, y, angka_K_20_bits, 11, 26, color);
      l += 13;
      continue;
    }
    if (c == 'M') {
      virtualDisp->drawBitmap(l+2, y, angka_M_20_bits, 17, 26, color);
      l += 19;
      continue;
    }
    if (c == 'N') {
      virtualDisp->drawBitmap(l+2, y, angka_N_20_bits, 14, 26, color);
      l += 17;
      continue;
    }
    // if (c == 'Z') {
    //   virtualDisp->drawBitmap(l+2, y, angka_Z_20_bits, 11, 26, color);
    //   l += 13;
    //   continue;
    // }
    if (c == 'T') {
      virtualDisp->drawBitmap(l+1, y, angka_T_20_bits, 12, 26, color);
      l += 14;
      continue;
    }
    if (c == 'V') {
      virtualDisp->drawBitmap(l+2, y, angka_V_20_bits, 13, 26, color);
      l += 15;
      continue;
    }
    if (c == 'W') {
      virtualDisp->drawBitmap(l+2, y, angka_W_20_bits, 18, 26, color);
      l += 20;
      continue;
    }
    if (c == '/') {
      virtualDisp->drawBitmap(l+1, y, angka_per_20_bits, 10, 26, color);
      l += 11;
      continue;
    }

    // karakter biasa
    virtualDisp->drawChar(
      l, (y + 25),
      c,
      color,
      virtualDisp->color444(15, 0, 0),
      1
    );

    l += getCharWidth20(c);
  }
}